#include "frequency_table.h"

FrequencyTable::FrequencyTable():
  positionArray{
    {
        {1612,1609,1613,0,0,0},
        {1601,1616,1614,1602,1615,1607},
        {1612,1616,1611,1609,1610,0},
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        {1607,1609,1606,1608,0,0},
      },
    {
        {1612,1609,1613,0,0,0},
        {1601,1616,1614,1602,1615,1607},
        {1612,1616,1611,1609,1610,0},
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        {1607,1609,1606,1608,0,0},
      },
    {
        {1612,1609,1613,0,0,0},
        {1601,1616,1614,1602,1615,1607},
        {1612,1616,1611,1609,1610,0},
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        {1610,1609,1606,1608,1612,0},
      },
  },
  freqsArray{
         100,
         0,
         108,100,
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         92,50,48,50,98,50,82,50,97,0,49,50,94,50,61,50,90,50,52,50,95,50,99,50,82,50,89,50,88,50,65,
   
  },
  freqsCountArray{
    {1,1,2,2,2,1,2,1,2,1,1,1,1,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14,},
    {1,1,2,2,2,1,2,1,2,1,1,1,1,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15,},
    {1,1,2,2,2,1,2,1,2,1,1,1,1,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31,},
  },
  freqsCountContextArray{
    0,7998,15799,
  }
{
  // Track the quantity
  sumCountFreqsArray = 0;
};

int FrequencyTable::getIndexFreqsArray( 
       int contextSize, int position, int key)
{

  // Init with de proba of preceding context size
  sumCountFreqsArray = \
    freqsCountContextArray[contextSize];
  
  // Compute sum until position-1
  for (int i=0; i<position; i++)
  {
    sumCountFreqsArray = sumCountFreqsArray + \
                          freqsCountArray[contextSize][i];
  }

  uint8_t countFreqsArray = freqsCountArray[ 
                        contextSize][position];
  int indexFreqsArray = this->getIndexFreqsArray( 
                        countFreqsArray, key);

  Serial.print("[DEBUG][FrequencyTable::getIndexFreqsArray] sumCountFreqsArray : ");
  Serial.println(sumCountFreqsArray);

  return indexFreqsArray;
}

int FrequencyTable::getIndexFreqsArray( 
       int countFreqsArray, int key)
{
  int indexFreqsArray = -1;
  int count = 0;
  int countTmp = 0;
  bool exitLoop = false;

  int i = 0;
  while((i < countFreqsArray) && (!exitLoop))
  {
    // Count number of value
    countTmp = (int)freqsArray[sumCountFreqsArray+i];
    // Compteur for equal freq value
    count = count + max(1, countTmp-100);

    // -1 because index start from 0
    if ((count-1) >= key)
    {
      indexFreqsArray = sumCountFreqsArray+i;
      exitLoop = true;
    }

    i = i + 1;
  }
  sumCountFreqsArray = sumCountFreqsArray+countFreqsArray;
  return indexFreqsArray;
}

int FrequencyTable::convertBinToInt( 
             uint8_t* dataBin, int sizeArrayBin)
{
int value = 0;

for(int i=0; i<sizeArrayBin; i++)
  {
    if (dataBin[i] == 1) // /!\ A CHANGER si bool !?
    {
    value = value + pow(
      2, sizeArrayBin-1-i);
    }
  }
  return value;
}

int FrequencyTable::computeKey(uint8_t* dataBin, 
                           int context,
                           int position)
{
  uint16_t* indexes = positionArray[
    context][position];
  uint8_t* keyArray = new uint8_t[KEY_SIZE];

  printf("[DEBUG][FrequencyTable::computeKey] indexes :\n");
  Serial.print("[ "); 
  for(int i = 0; i < KEY_SIZE-1; i++) { 
    Serial.print(indexes[i]);
    Serial.print(", ");
  }

  // Print last element
  Serial.print(indexes[KEY_SIZE-1]);
  Serial.println(" ]");

  // Extract value of array 
  for(int i=0; i<KEY_SIZE; i++)
  {
    // If index equal is -1 then indexes[i] == 0
    if(indexes[i] == -1)
    {
      keyArray[i] = 0;
    } else {
      keyArray[i] = dataBin[indexes[i]-1];
    }
  }

  printf("[DEBUG][FrequencyTable::computeKey] keyArray :\n");
  Serial.print("[ "); 
  for(int i = 0; i < KEY_SIZE-1; i++) { 
    Serial.print(keyArray[i]);
    Serial.print(", ");
  }

  // Print last element
  Serial.print(keyArray[KEY_SIZE-1]);
  Serial.println(" ]");

  printf("[DEBUG][FrequencyTable::computeKey] dataBin :\n");
  int sizeDataBin = 1600+16;
  Serial.print("[ "); 
  for(int i = sizeDataBin-20; i < sizeDataBin-1; i++) { 
    Serial.print(dataBin[i]);
    Serial.print(", ");
  }

  // Print last element
  Serial.print(dataBin[sizeDataBin-1]);
  Serial.println(" ]");

  // Convert binary array to int
  int key = this->convertBinToInt(
    keyArray, KEY_SIZE);
  delete[] keyArray;

  return key;
}

float* FrequencyTable::computeFrequency( 
           int indexFreqsArray)
{
  // Check if position is a compress field (eq > 100)
  // If number is on the trailling value
  float freq;
  if (indexFreqsArray == -1)
  {
    freq = 0.5;
  }
  else
  {
    freq = freqsArray[indexFreqsArray] / 100.;
  }

  // If number is on 100 
  float* freqs = new float[ALPHABET_SIZE];
  if (freq > 1)
  {
    freqs[0] = 0.5;
  }
  else
  {
    freqs[0] = freq;
  }

  freqs[1] = 1-freqs[0];
  return freqs;
}

float* FrequencyTable::nextFrequency(uint8_t* dataBin, 
                            int contextSize, 
                            int position) 
{
  // Extract value from position
  int key = this->computeKey( 
         dataBin, contextSize, position);

  uint8_t countFreqsArray = freqsCountArray[ 
             contextSize][position];
  int indexFreqsArray = this->getIndexFreqsArray( 
           countFreqsArray, key);

  float* freqs = this->computeFrequency( 
                       indexFreqsArray);

  Serial.print("[DEBUG][FrequencyTable::nextFrequency] freqs : ");
  Serial.print("[ "); 
  for(int i = 0; i < ALPHABET_SIZE-1; i++) { 
    Serial.print(freqs[i]);
    Serial.print(", ");
  }

  // Print last element
  Serial.print(freqs[ALPHABET_SIZE-1]);
  Serial.println(" ]");

  Serial.print("[DEBUG][FrequencyTable::nextFrequency] self.index_pos[ctx[i], pos[i]] : ");
  Serial.print(contextSize);
  Serial.print(", ");
  Serial.println(position);
  
  return freqs;
}

float* FrequencyTable::getFrequency(uint8_t* dataBin,
                           int contextSize,
                           int position)
{
  // Extract value from position
  int key = this->computeKey(
    dataBin, contextSize, position);

  // Init with pre-calculate context
  sumCountFreqsArray = freqsCountContextArray[ 
                            contextSize];
  int indexFreqsArray = this->getIndexFreqsArray( 
                            contextSize, position, key);
  Serial.print("[DEBUG][FrequencyTable::nextFrequency] indexFreqsArray : ");
  Serial.print(indexFreqsArray);

  float* freqs = this->computeFrequency( 
                        indexFreqsArray);
  return freqs;
}
